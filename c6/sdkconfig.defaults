## firmware/components/board/Kconfig
```kconfig
menu "Lichen display"
    config LICHEN_DISPLAY_DIRECT_FLUSH
        bool "Rotate LVGL strips straight into the panel frame buffer"
        default y
        help
            Lichen's own flush callback turns each rendered 720x80 strip by 90 degrees directly into the DSI
            panel's frame buffer, instead of esp_lvgl_port rotating it into a second PSRAM buffer and the DPI
            driver copying that into the frame buffer with DMA2D (#95). Saves two PSRAM passes per strip and
            the port's 112 KB rotation buffer. Off = the port's path, untouched.

    choice LICHEN_DISPLAY_DIRECT_FLUSH_ENGINE
        prompt "What rotates the strip"
        depends on LICHEN_DISPLAY_DIRECT_FLUSH
        default LICHEN_DISPLAY_DIRECT_FLUSH_CPU

        config LICHEN_DISPLAY_DIRECT_FLUSH_PPA
            bool "PPA (blocking scale-rotate-mirror)"
        config LICHEN_DISPLAY_DIRECT_FLUSH_CPU
            bool "CPU (lv_draw_sw_rotate, then a cache write-back of the touched rows)"
    endchoice
endmenu
```

## firmware/components/fw_console/Kconfig
```kconfig
menu "Lichen console"
    config LICHEN_DEV_COMMANDS
        bool "Debug and test console commands (developer mode, #373)"
        default y
        help
            Builds the commands registered with console_register_dev and `fw dev [on|off|status]`. At runtime they
            run only while developer mode is on (About: press Enter 7 times, or `fw dev on` from the USB console;
            never over Wi-Fi) and are hidden from `fw help` while it is off. Off in the release build
            (sdkconfig.release.defaults, `build.sh release build`): the commands are then not in the image.
endmenu
```

## firmware/components/lichen_clock/Kconfig
```kconfig
menu "Lichen clock"
    config LICHEN_CLOCK_PSRAM_RECORD
        bool
        default y
        depends on SPIRAM
        select SPIRAM_ALLOW_NOINIT_SEG_EXTERNAL_MEMORY
        help
            The minute clock record (clock_save.c, #343) lives in PSRAM's no-init segment, the only store #330
            found to survive the CH340 EN (system) reset without a flash write.
endmenu
```

## firmware/components/lichen_nvs/Kconfig.projbuild
```kconfig
menu "Lichen NVS encryption (#116)"
    config LICHEN_NVS_ENCRYPT
        bool "Keep NVS encrypted once an HMAC key is burned"
        default n
        help
            Compiles the encrypted-NVS boot path. It only ever USES a key: with no HMAC key in the configured eFuse
            block (LICHEN_NVS_HMAC_KEY_ID) NVS stays plain, exactly as with this option off. It never creates or burns a
            key. With a key present, a plaintext NVS is copied to RAM once, the partition is erased and the entries are
            written back encrypted. Do not turn on IDF's CONFIG_NVS_ENCRYPTION instead: its init burns a key by itself.
            Read docs/nvs-encryption.md first.

    config LICHEN_NVS_HMAC_KEY_ID
        int "eFuse key block holding the NVS HMAC key (0..5 = KEY0..KEY5)"
        range 0 5
        default 5
        help
            Last block, so KEY0.. stay free for secure boot or flash encryption later. Set in every build, not only
            with LICHEN_NVS_ENCRYPT: a build without it still reads this block's key purpose (read only) and leaves
            NVS alone when a key is burned, since a plain init would erase an encrypted partition entry by entry.

    config LICHEN_NVS_ENCRYPT_BURN_CMD
        bool "Compile fw nvs-enc burn (IRREVERSIBLE eFuse burn)"
        depends on LICHEN_NVS_ENCRYPT
        default n
        help
            Adds "fw nvs-enc burn YES": writes a random 32-byte key with purpose HMAC_UP into the configured block, read
            and write protected. Irreversible; the key cannot be read back or changed. Leave off in every build that is
            not the one deliberate burn build.

    config LICHEN_NVS_DEBUG_FORCE_DOWN
        bool "Compile fw nvs-down YES (bench only: the next boot leaves NVS down)"
        default n
        help
            Adds "fw nvs-down YES" (USB console only): the next boot takes the burned-key "stays down" path once,
            without initialising or erasing NVS, so the boot without settings and the refused Wi-Fi updates can be
            seen on a badge with no key burned. Nothing is written to flash or eFuse; the boot after is normal again.
endmenu
```

## firmware/components/lichen_os/Kconfig
```kconfig
menu "Lichen UI service"
    choice LICHEN_UI_LOCK_CHECK_MODE
        prompt "Debug lock-owner check: LVGL touched without the LVGL lock (#225)"
        default LICHEN_UI_LOCK_CHECK_COUNT
        help
            Wraps LVGL's allocator (lv_malloc, lv_malloc_zeroed, lv_calloc, lv_zalloc, lv_realloc, lv_reallocf,
            lv_free) and lv_inv_area at link time. A call from a task that is neither the LVGL task nor inside
            lichen_sys_ui_lock is a hit. Armed once boot has set up the display and keyboard (board takes the port
            lock directly for that). This project has no build with assertions off, so whatever mode is chosen here
            is in every image. Cost once armed: some 40-60 cycles per wrapped call, about 0.3-0.7 ms of a full-screen
            frame. LVGL must run without draw threads (LV_USE_OS none, as now): with LV_USE_OS set, LVGL's draw
            threads would allocate off the LVGL task and trip the check.

        config LICHEN_UI_LOCK_CHECK_OFF
            bool "Off (no wraps)"
        config LICHEN_UI_LOCK_CHECK_COUNT
            bool "Count and log the first hit per call site (fw ui lockcheck)"
        config LICHEN_UI_LOCK_CHECK_ASSERT
            bool "Log and assert on the first hit"
            depends on COMPILER_OPTIMIZATION_ASSERTIONS_ENABLE
    endchoice

    config LICHEN_UI_LOCK_CHECK
        bool
        default y if LICHEN_UI_LOCK_CHECK_COUNT || LICHEN_UI_LOCK_CHECK_ASSERT
endmenu
```

## firmware/components/ota/Kconfig.projbuild
```kconfig
menu "Lichen Wi-Fi update server"
    config OTA_WIFI_CONSOLE
        bool "Run fw console commands over Wi-Fi (POST /console)"
        default y
        help
            With the update token, tools/badge.sh fw <ip> <command> runs any console command, which is as much as
            the USB console can do (#38). Turn off to answer 404.
endmenu
```

## firmware/components/sensors/Kconfig
```kconfig
menu "Lichen sensors"
    config LICHEN_SENSORS_IMU_PERIOD_MS
        int "BMI270 sampling period (ms)"
        default 100
        range 20 1000
        help
            How often the sensors task reads the IMU (accel 100 Hz, gyro 100 Hz output rate). Apps can change it
            at run time with lichen_sensors_set_periods().

    config LICHEN_SENSORS_ENV_PERIOD_MS
        int "BME690 and P4 temperature sampling period (ms)"
        default 1000
        range 1000 60000
        help
            One forced BME690 measurement (with the gas heater, if on) and one P4 die temperature read per period.

    config LICHEN_SENSORS_I2C_HZ
        int "I2C clock for the two sensor chips (Hz)"
        default 100000
        range 100000 400000
        help
            The keyboard chip on the same bus runs at 100 kHz; both sensors can do 400 kHz.
    config LICHEN_SENSORS_GAS_HEATER
        bool "BME690 gas heater (gas resistance readings)"
        default y
        help
            The gas reading needs the BME690's hot plate at 300 C for a moment in every measurement. That heat
            reaches the chip's own temperature and humidity sensors: with the heater on they read somewhat warm
            (and humidity somewhat low), more so with a longer heater time or a shorter period. Off: no gas
            reading, no self-heating.

    config LICHEN_SENSORS_HEATER_MS
        int "Gas heater time per measurement (ms)"
        depends on LICHEN_SENSORS_GAS_HEATER
        default 100
        range 20 500
        help
            How long the hot plate is held at 300 C in each measurement (heater duty = this / the environment
            period, 10 % by default). Shorter heats less but the gas reading may not settle (gas -- in fw sensors).
endmenu
```
