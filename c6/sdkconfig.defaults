## firmware/components/board/Kconfig
```kconfig
menu "Lichen display"
    config LICHEN_DISPLAY_DIRECT_FLUSH
        bool "Rotate LVGL strips straight into the panel frame buffer"
        default y
        help
            Lichen's own flush callback turns each rendered 720x80 strip by 90 degrees directly into the DSI
            panel's frame buffer, instead of esp_lvgl_port rotating it into a second PSRAM buffer and the DPI
            driver copying that into the frame buffer with DMA2D (#95). Saves two PSRAM passes per strip and
            the port's 112 KB rotation buffer. Tear-free since #467: strips go into the second frame buffer,
            which is swapped in at the end of the frame. Off = the port's path, untouched (one buffer shown).
            What turns the strip is chosen at runtime (#468, #475): the PPA in the background at every boot, in both
            builds, with a fallback to the CPU; in a developer build the registry key disp.engine switches to cpu.
endmenu
```

## firmware/components/fw_console/Kconfig
```kconfig
menu "Lichen console"
    config LICHEN_DEV_COMMANDS
        bool "Debug and test console commands (developer mode, #373)"
        default y
        help
            Builds the commands registered with console_register_dev and `fw dev [on|off|status]`. At runtime they
            run only while developer mode is on (About: press Enter 7 times, or `fw dev on` from the USB console;
            never over Wi-Fi; a dev image with LICHEN_BENCH_OPEN: also over Wi-Fi) and are hidden from `fw help` while it is off. Off in the release build
            (sdkconfig.release.defaults, `build.sh release build`): the commands are then not in the image.

    config LICHEN_BENCH_OPEN
        bool "Bench-open: remote reach for the bench in a developer image (#488)"
        default y
        depends on LICHEN_DEV_COMMANDS
        help
            Lets the main session bench the developer image without hands: `fw ui answer` may confirm the local DANGER
            dialogs (not the ones that change what a third node does, the Wi-Fi updates or developer mode switches off),
            `fw dev on` works over Wi-Fi, and injected keys count for About's taps and the boot factory-reset combo.
            Off in the release build (sdkconfig.release.defaults; tools/check_release_image.sh config wants it off and
            LICHEN-BENCH-OPEN-MARKER absent from the image): the release keeps every hand-only refusal.
endmenu
```
